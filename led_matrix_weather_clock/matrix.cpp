// Матрица: координаты -> номер светодиода, шрифты цифр и букв.
#include "matrix.h"
#include "state.h"

CRGB leds[NUM_LEDS];

// ========== XY ==========
int XY(int x, int y) {
  if (x < 0 || x >= MATRIX_W || y < 0 || y >= MATRIX_H) return -1;
  return (x % 2 == 0) ? x * 8 + y : x * 8 + (7 - y);
}

// =====================================================================
//  ШРИФТ ЦИФР
// =====================================================================
const byte digits[10][7][5] = {
  {{0,1,1,1,0},{1,0,0,0,1},{1,0,0,0,1},{1,0,0,0,1},{1,0,0,0,1},{1,0,0,0,1},{0,1,1,1,0}},
  {{0,1,1,0,0},{1,1,1,0,0},{0,1,1,0,0},{0,1,1,0,0},{0,1,1,0,0},{0,1,1,0,0},{1,1,1,1,1}},
  {{1,1,1,1,0},{0,0,0,0,1},{0,0,0,0,1},{0,1,1,1,0},{1,0,0,0,0},{1,0,0,0,0},{1,1,1,1,1}},
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  {{0,1,1,1,0},{1,0,0,0,1},{1,0,0,0,1},{0,1,1,1,1},{0,0,0,0,1},{0,0,0,0,1},{0,1,1,1,0}}
};

void drawDigit(int digit, int startX, int startY, CRGB color) {
  if (digit < 0 || digit > 9) return;
  for (int y = 0; y < 7; y++)
    for (int x = 0; x < 5; x++)
      if (digits[digit][y][x]) setPixel(startX + x, startY + y, color);
}

void drawNumber(int num, CRGB color) {
  FastLED.clear();
  char str[6];
  snprintf(str, sizeof(str), "%d", num);
  int len = strlen(str);
  int totalWidth = len * 6;
  int startX = (MATRIX_W - totalWidth) / 2;
  for (int i = 0; i < len; i++) {
    char c = str[i];
    if (c == '-') setPixel(startX + i * 6 + 2, 3, color); else {
      drawDigit(c - '0', startX + i * 6, 0, color);
    }
  }
}

// =====================================================================
//  РУССКИЙ ШРИФТ 5x7
// =====================================================================
const byte russianLetters[33][7][5] = {
  {{0,1,1,1,0},{1,0,0,0,1},{1,0,0,0,1},{1,1,1,1,1},{1,0,0,0,1},{1,0,0,0,1},{1,0,0,0,1}},
  {{1,1,1,1,1},{1,0,0,0,0},{1,0,0,0,0},{1,1,1,1,0},{1,0,0,0,1},{1,0,0,0,1},{1,1,1,1,0}},
  {{1,1,1,1,0},{1,0,0,0,1},{1,0,0,0,1},{1,1,1,1,0},{1,0,0,0,1},{1,0,0,0,1},{1,1,1,1,0}},
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  {{0,1,1,1,0},{1,0,0,0,1},{1,0,0,0,1},{1,1,1,1,1},{1,0,0,0,1},{1,0,0,0,1},{1,0,0,0,1}}
};

// ---------------------------------------------------------------------
//  Латиница A–Z и знаки. Каждый знак — 7 строк по 5 точек,
//  старший из пяти битов (0b10000) — левая точка.
// ---------------------------------------------------------------------
static const uint8_t latinLetters[26][7] PROGMEM = {
  {0b01110,0b10001,0b10001,0b11111,0b10001,0b10001,0b10001}, // A
  {0b11110,0b10001,0b10001,0b11110,0b10001,0b10001,0b11110}, // B
  {0b01110,0b10001,0b10000,0b10000,0b10000,0b10001,0b01110}, // C
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  {0b11111,0b00001,0b00010,0b00100,0b01000,0b10000,0b11111}, // Z
};

static const char PUNCT_CHARS[] = ".,:-!?+/%()'\"=";   // + знак градуса (отдельно)
#define PUNCT_COUNT 15
static const uint8_t punctGlyphs[PUNCT_COUNT][7] PROGMEM = {
  {0b00000,0b00000,0b00000,0b00000,0b00000,0b01100,0b01100}, // .
  {0b00000,0b00000,0b00000,0b00000,0b01100,0b00100,0b01000}, // ,
  {0b00000,0b01100,0b01100,0b00000,0b01100,0b01100,0b00000}, // :
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  {0b01100,0b10010,0b10010,0b01100,0b00000,0b00000,0b00000}, // °
};

// Номера знаков в общем шрифте:
//   0..32  — кириллица (russianLetters),  33..58 — латиница,
//   59..68 — цифры (digits),  69..83 — знаки,  255 — пробел.
#define GLYPH_LATIN  33
#define GLYPH_DIGIT  59
#define GLYPH_PUNCT  69

int mapUnicodeToIndex(uint16_t unicode) {
  if (unicode >= 0x0410 && unicode <= 0x042F) return unicode - 0x0410;  // А..Я
  if (unicode >= 0x0430 && unicode <= 0x044F) return unicode - 0x0430;  // а..я -> заглавные
  if (unicode == 0x0401 || unicode == 0x0451) return 5;                 // Ё, ё -> Е
  if (unicode >= 'A' && unicode <= 'Z') return GLYPH_LATIN + (unicode - 'A');
  if (unicode >= 'a' && unicode <= 'z') return GLYPH_LATIN + (unicode - 'a');
  if (unicode >= '0' && unicode <= '9') return GLYPH_DIGIT + (unicode - '0');
  if (unicode == 0x00B0) return GLYPH_PUNCT + PUNCT_COUNT - 1;          // °
  for (int i = 0; PUNCT_CHARS[i]; i++)
    if (unicode == (uint8_t)PUNCT_CHARS[i]) return GLYPH_PUNCT + i;
  return -1;
}

void utf8ToIndices(String input, uint8_t* outBuf, int maxLen, int& outLen) {
  outLen = 0;
  unsigned int i = 0;
  while (i < input.length() && outLen < maxLen) {
    uint16_t unicode;
    unsigned char c = input[i];
    if ((c & 0x80) == 0) { unicode = c; i++; }
    else if ((c & 0xE0) == 0xC0) { if (i+1<input.length()) { unicode = ((c&0x1F)<<6)|(input[i+1]&0x3F); i+=2; } else break; }
    else if ((c & 0xF0) == 0xE0) { if (i+2<input.length()) { unicode = ((c&0x0F)<<12)|((input[i+1]&0x3F)<<6)|(input[i+2]&0x3F); i+=3; } else break; }
    else { i++; continue; }
    int idx = mapUnicodeToIndex(unicode);
    if (idx >= 0) outBuf[outLen++] = (uint8_t)idx;
    else if (unicode == ' ') outBuf[outLen++] = 255;
  }
}

static void drawRows(const uint8_t* rowsProgmem, int startX, int startY, CRGB color) {
  for (int y = 0; y < 7; y++) {
    uint8_t row = pgm_read_byte(rowsProgmem + y);
    for (int x = 0; x < 5; x++)
      if (row & (0b10000 >> x)) setPixel(startX + x, startY + y, color);
  }
}

void drawLetter(int index, int startX, int startY, CRGB color) {
  if (index < 0) return;
  if (index < 33) {
    for (int y = 0; y < 7; y++)
      for (int x = 0; x < 5; x++)
        if (russianLetters[index][y][x]) setPixel(startX + x, startY + y, color);
  } else if (index < GLYPH_DIGIT) {
    drawRows(latinLetters[index - GLYPH_LATIN], startX, startY, color);
  } else if (index < GLYPH_PUNCT) {
    drawDigit(index - GLYPH_DIGIT, startX, startY, color);
  } else if (index < GLYPH_PUNCT + PUNCT_COUNT) {
    drawRows(punctGlyphs[index - GLYPH_PUNCT], startX, startY, color);
  }
}

void drawGlyphLine(const uint8_t* glyphs, int len, int x0, int y0, CRGB color) {
  for (int i = 0; i < len; i++) {
    int x = x0 + i * 6;
    if (x > -6 && x < MATRIX_W && glyphs[i] != 255) drawLetter(glyphs[i], x, y0, color);
  }
}
